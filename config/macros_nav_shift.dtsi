mod_morph_t: mod_morph_t {
	compatible = "zmk,behavior-mod-morph";
	label = "mod_morph_t";
	#binding-cells = <0>;
	bindings = <&kp DOWN>, <&txt_ement>;
	mods = <(MOD_LSFT|MOD_RSFT)>;
};

mod_morph_n: mod_morph_n {
	compatible = "zmk,behavior-mod-morph";
	label = "mod_morph_n";
	#binding-cells = <0>;
	bindings = <&kp UP>, <&txt_ation>;
	mods = <(MOD_LSFT|MOD_RSFT)>;
};



txt_ement: txt_ement {
	compatible = "zmk,behavior-macro";
	label = "txt_ement";
	tap-ms = <10>;
	#binding-cells = <0>;
	bindings = <&macro_tap &kp OPT7_E &kp OPT7_M &kp OPT7_E &kp OPT7_N &kp OPT7_T>;
};

txt_ation: txt_ation {
	compatible = "zmk,behavior-macro";
	label = "txt_ation";
	tap-ms = <10>;
	#binding-cells = <0>;
	bindings = <&macro_tap &kp OPT7_A &kp OPT7_T &kp OPT7_I &kp OPT7_O &kp OPT7_N>;
};

