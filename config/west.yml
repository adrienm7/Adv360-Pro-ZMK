## config/west.yml
```yaml
manifest:
    remotes:
        - name: zmkfirmware
          url-base: https://github.com/zmkfirmware
        - name: refil
          url-base: https://github.com/refil
        - name: adrienm7
          url-base: https://github.com/adrienm7
    projects:
        - name: zmk
          remote: adrienm7
          revision: adv360-z3
          import: app/west.yml
    self:
        path: config
```
